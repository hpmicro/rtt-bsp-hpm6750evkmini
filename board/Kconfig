## projects/ethernet_demo/board/Kconfig
```kconfig
menu "Hardware Drivers Config"

config SOC_HPM6000
    bool
    select SOC_SERIES_HPM6000
    select RT_USING_COMPONENTS_INIT
    select RT_USING_USER_MAIN
    default y

menu "On-chip Peripheral Drivers"
    config BSP_USING_GPIO
        bool "Enable GPIO"
        select RT_USING_PIN
        default n

    menuconfig BSP_USING_UART
        bool "Enable UART"
        default y
        select RT_USING_SERIAL
        if BSP_USING_UART
            config BSP_USING_UART0
                bool "Enable UART0"
                    default y

            config BSP_USING_UART2
                bool "Enable UART2"
                    default y
        endif

    menuconfig BSP_USING_SPI
        bool "Enable SPI"
        default y
        select RT_USING_SPI
        if BSP_USING_SPI
            config BSP_USING_SPI0
                bool "Enable SPI0"
                    default n

            config BSP_USING_SPI1
                bool "Enable SPI1"
                    default y
        endif	
       
    menuconfig BSP_USING_RTC
       bool "Enable RTC"
       default y
    
    menuconfig BSP_USING_ETH
       bool "Enable Ethernet"
       default n
       
    menuconfig BSP_USING_DRAM
       bool "Enable DRAM"
       default y
    menuconfig INIT_EXT_RAM_FOR_DATA
        bool "INIT_EXT_RAM_FOR_DATA"
        default y

endmenu


endmenu
```

## projects/lv_demo_widgets/board/Kconfig
```kconfig
menu "Hardware Drivers Config"

config SOC_HPM6000
    bool
    select SOC_SERIES_HPM6000
    select RT_USING_COMPONENTS_INIT
    select RT_USING_USER_MAIN
    default y

menu "On-chip Peripheral Drivers"
    config BSP_USING_GPIO
        bool "Enable GPIO"
        select RT_USING_PIN
        default n

    menuconfig BSP_USING_UART
        bool "Enable UART"
        default y
        select RT_USING_SERIAL
        if BSP_USING_UART
            config BSP_USING_UART0
                bool "Enable UART0"
                    default y

            config BSP_USING_UART2
                bool "Enable UART2"
                    default y
        endif

    menuconfig BSP_USING_SPI
        bool "Enable SPI"
        default y
        select RT_USING_SPI
        if BSP_USING_SPI
            config BSP_USING_SPI0
                bool "Enable SPI0"
                    default n

            config BSP_USING_SPI1
                bool "Enable SPI1"
                    default y
        endif

    menuconfig BSP_USING_RTC
       bool "Enable RTC"
       default y
    menuconfig BSP_USING_LCD
       bool "Enable LCD"
       default y
    menuconfig BSP_USING_DRAM
       bool "Enable DRAM"
       default y
	menuconfig INIT_EXT_RAM_FOR_DATA
		bool "INIT_EXT_RAM_FOR_DATA"
		default y
    menuconfig BSP_USING_TOUCH
       bool "Enable touch"
       default y
        if BSP_USING_TOUCH
            config BSP_USING_TOUCH_GT911
                bool "Enable GT911"
                    default y

            config BSP_USING_TOUCH_FT5406
                bool "Enable FT5406"
                    default n
        endif
        
    menuconfig BSP_USING_LVGL
        bool "Enable LVGL"
        default y
        select PKG_USING_LVGL

        
    menuconfig BSP_USING_GPTMR
       bool "Enable GPTIMER"
       default y  
        if BSP_USING_GPTMR
            config BSP_USING_GPTMR7
                bool "Enable GPTMR7"
                    default y
        endif   
    menuconfig BSP_USING_I2C
        bool "Enable I2C"
        default y
        if BSP_USING_I2C
            config BSP_USING_I2C0
                bool "Enable I2C0"
                    default y

            config BSP_USING_I2C1
                bool "Enable I2C1"
                    default n
        endif
endmenu


endmenu
```
