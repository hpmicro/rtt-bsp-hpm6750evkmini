## board/Kconfig
```kconfig
menu "Hardware Drivers Config"

config SOC_HPM6000
    bool
    select SOC_SERIES_HPM6000
    select RT_USING_COMPONENTS_INIT
    select RT_USING_USER_MAIN
    default y

menu "On-chip Peripheral Drivers"
    config BSP_USING_GPIO
        bool "Enable GPIO"
        select RT_USING_PIN if BSP_USING_GPIO
        default n

    menuconfig BSP_USING_UART
        bool "Enable UART"
        default y
        select RT_USING_SERIAL
        
        if BSP_USING_UART
            menuconfig BSP_USING_UART0
                bool "Enable UART0 (Debugger)"
                default y
                if BSP_USING_UART0
                    config BSP_UART0_RX_USING_DMA
                        bool "Enable UART0 RX DMA"
                        depends on BSP_USING_UART0 && RT_SERIAL_USING_DMA
                        default n

                    config BSP_UART0_TX_USING_DMA
                        bool "Enable UART0 TX DMA"
                        depends on BSP_USING_UART0 && RT_SERIAL_USING_DMA
                        default n

                    config BSP_UART0_RX_DMA_CHANNEL
                        int "Set UART0 RX DMA CHANNEL"
                        range 0 7
                        depends on BSP_USING_UART0 && RT_SERIAL_USING_DMA
                        default 0

                    config BSP_UART0_TX_DMA_CHANNEL
                        int "Set UART0 TX DMA CHANNEL"
                        range 0 7
                        depends on BSP_USING_UART0 && RT_SERIAL_USING_DMA
                        default 1

                    config BSP_UART0_RX_BUFSIZE
                        int "Set UART0 RX buffer size"
                        range 64 65535
                        depends on RT_USING_SERIAL_V2
                        default 128

                    config BSP_UART0_TX_BUFSIZE
                        int "Set UART0 TX buffer size"
                        range 0 65535
                        depends on RT_USING_SERIAL_V2
                        default 0
                endif
                menuconfig BSP_USING_UART6
                bool "Enable UART6"
                default n
                if BSP_USING_UART6
                    config BSP_UART6_RX_USING_DMA
                        bool "Enable UART6 RX DMA"
                        depends on BSP_USING_UART6 && RT_SERIAL_USING_DMA
                        default n

                    config BSP_UART6_TX_USING_DMA
                        bool "Enable UART6 TX DMA"
                        depends on BSP_USING_UART6 && RT_SERIAL_USING_DMA
                        default n

                    config BSP_UART6_RX_DMA_CHANNEL
                        int "Set UART6 RX DMA CHANNEL"
                        range 0 7
                        depends on BSP_USING_UART6 && RT_SERIAL_USING_DMA
                        default 0

                    config BSP_UART6_TX_DMA_CHANNEL
                        int "Set UART6 TX DMA CHANNEL"
                        range 0 7
                        depends on BSP_USING_UART6 && RT_SERIAL_USING_DMA
                        default 1

                    config BSP_UART6_RX_BUFSIZE
                        int "Set UART6 RX buffer size"
                        range 64 65535
                        depends on RT_USING_SERIAL_V2
                        default 128

                    config BSP_UART6_TX_BUFSIZE
                        int "Set UART6 TX buffer size"
                        range 0 65535
                        depends on RT_USING_SERIAL_V2
                        default 0
                endif
                menuconfig BSP_USING_UART13
                bool "Enable UART13"
                default n
                if BSP_USING_UART13
                    config BSP_UART13_RX_USING_DMA
                        bool "Enable UART13 RX DMA"
                        depends on BSP_USING_UART13 && RT_SERIAL_USING_DMA
                        default n

                    config BSP_UART13_TX_USING_DMA
                        bool "Enable UART13 TX DMA"
                        depends on BSP_USING_UART13 && RT_SERIAL_USING_DMA
                        default n

                    config BSP_UART13_RX_DMA_CHANNEL
                        int "Set UART13 RX DMA CHANNEL"
                        range 0 7
                        depends on BSP_USING_UART13 && RT_SERIAL_USING_DMA
                        default 0

                    config BSP_UART13_TX_DMA_CHANNEL
                        int "Set UART13 TX DMA CHANNEL"
                        range 0 7
                        depends on BSP_USING_UART13 && RT_SERIAL_USING_DMA
                        default 1

                    config BSP_UART13_RX_BUFSIZE
                        int "Set UART13 RX buffer size"
                        range 64 65535
                        depends on RT_USING_SERIAL_V2
                        default 128

                    config BSP_UART13_TX_BUFSIZE
                        int "Set UART13 TX buffer size"
                        range 0 65535
                        depends on RT_USING_SERIAL_V2
                        default 0
                endif
                menuconfig BSP_USING_UART14
                bool "Enable UART14"
                default n
                if BSP_USING_UART14
                    config BSP_UART14_RX_USING_DMA
                        bool "Enable UART14 RX DMA"
                        depends on BSP_USING_UART14 && RT_SERIAL_USING_DMA
                        default n

                    config BSP_UART14_TX_USING_DMA
                        bool "Enable UART14 TX DMA"
                        depends on BSP_USING_UART14 && RT_SERIAL_USING_DMA
                        default n

                    config BSP_UART14_RX_DMA_CHANNEL
                        int "Set UART14 RX DMA CHANNEL"
                        range 0 7
                        depends on BSP_USING_UART14 && RT_SERIAL_USING_DMA
                        default 0

                    config BSP_UART14_TX_DMA_CHANNEL
                        int "Set UART14 TX DMA CHANNEL"
                        range 0 7
                        depends on BSP_USING_UART14 && RT_SERIAL_USING_DMA
                        default 1

                    config BSP_UART14_RX_BUFSIZE
                        int "Set UART14 RX buffer size"
                        range 64 65535
                        depends on RT_USING_SERIAL_V2
                        default 128

                    config BSP_UART14_TX_BUFSIZE
                        int "Set UART14 TX buffer size"
                        range 0 65535
                        depends on RT_USING_SERIAL_V2
                        default 0
                endif
        endif
        


    menuconfig BSP_USING_SPI
        bool "Enable SPI"
        default n
        select RT_USING_SPI if BSP_USING_SPI
        if BSP_USING_SPI
            config BSP_USING_SPI1
                bool "Enable SPI1"
                    default y
            config BSP_USING_SPI2
                bool "Enable SPI2"
                    default n
            config BSP_USING_SPI3
                bool "Enable SPI3"
                    default n
        endif

    menuconfig BSP_USING_RTC
       bool "Enable RTC"
       default n

    menuconfig BSP_USING_ETH
       bool "Enable Ethernet"
       default n

    menuconfig BSP_USING_SDXC
        bool "Enable SDXC"
        default n
        select RT_USING_SDIO if BSP_USING_SDXC
        if BSP_USING_SDXC
            config BSP_USING_SDXC0
                bool "Enable SDXC0"
                    default n

            config BSP_USING_SDXC1
                bool "Enable SDXC1"
                    default y
        endif

    menuconfig BSP_USING_TOUCH
       bool "Enable touch"
       default n
        if BSP_USING_TOUCH
            config BSP_USING_TOUCH_GT911
                bool "Enable GT911"
                    default y

            config BSP_USING_TOUCH_FT5406
                bool "Enable FT5406"
                    default n
        endif

    menuconfig BSP_USING_LCD
    	bool "Enable LCD"
    	default n

    menuconfig BSP_USING_LVGL
        bool "Enable LVGL"
        default n
        select PKG_USING_LVGL if BSP_USING_LVGL

    menuconfig BSP_USING_GPTMR
       bool "Enable GPTIMER"
       default n
        if BSP_USING_GPTMR
            config BSP_USING_GPTMR7
                bool "Enable GPTMR7"
                    default y
        endif
    menuconfig BSP_USING_I2C
        bool "Enable I2C"
        default n
        if BSP_USING_I2C
            config BSP_USING_I2C0
                bool "Enable I2C0"
                    default y

            config BSP_USING_I2C3
                bool "Enable I2C3"
                    default n
        endif

    menuconfig BSP_USING_DRAM
       bool "Enable DRAM"
       default y
    menuconfig INIT_EXT_RAM_FOR_DATA
        bool "INIT_EXT_RAM_FOR_DATA"
        default y
        
        
    menuconfig BSP_USING_XPI_FLASH
    	bool "Enable XPI FLASH"
	default n 
    	select PKG_USING_FAL if BSP_USING_XPI_FLASH

    menuconfig BSP_USING_PWM
        bool "Enable PWM"
	default n

    menuconfig BSP_USING_USB
       bool "Enable USB"
       default n
       if BSP_USING_USB
       		config BSP_USING_USB_DEVICE
                bool "Enable USB Device"
                    default n
       endif
endmenu



endmenu
```

## common/libraries/third_party/RT-Thread-Insight/RT-Tunnel/Kconfig
```kconfig
# Kconfig file for RT-Tunnel
menuconfig RT_USING_RT_TUNNEL
    bool "RT-Tunnel: Auxiliary communication with RT-Trace tool and the target."
    default n

if RT_USING_RT_TUNNEL
    config TUNNEL_NUM
        int "Tunnel number"
        default 3

    config TUNNEL_BUFFER_SIZE
        int "Tunnel buffer size (bytes)"
        default 8192
        help
            Configure the buffer size for each tunnel.
endif
```

## common/libraries/third_party/RT-Thread-Insight/rti/Kconfig
```kconfig
menuconfig RT_USING_RTI
    bool "RT-Thread Insight: probe tool for RT-Thread"
    select RT_USING_HOOK
    select RT_USING_CPUTIME
    select BSP_USING_MCHTMR
    default n

if RT_USING_RTI

    config BOARD_SYSTICK_FREQ_IN_HZ
        int "CPU frequency (Hz)"
        default 480000000
        help
            Required for v2.0.0+ version: CPU clock frequency, used for timestamp calculation.

    config RT_RTI_SCHEDULER_HOOK
        bool "Use scheduler hook"
        default y
        help
            Enable RT-Thread scheduler hook for thread switch events.

    config RT_RTI_THREAD_RESUME_HOOK
        bool "Use thread resume hook"
        default y
        help
            Enable RT-Thread thread resume hook.

    config RT_RTI_THREAD_SUSPEND_HOOK
        bool "Use thread suspend hook"
        default y
        help
            Enable RT-Thread thread suspend hook.

    config RT_RTI_INTERRUPT_ENTER_HOOK
        bool "Use interrupt enter hook"
        default y
        help
            Enable RT-Thread interrupt enter hook.

    config RT_RTI_INTERRUPT_LEAVE_HOOK
        bool "Use interrupt leave hook"
        default y
        help
            Enable RT-Thread interrupt leave hook.

    config RT_RTI_OBJECT_TAKE_HOOK
        bool "Use object take hook"
        default y
        help
            Enable RT-Thread object take hook for semaphore, mutex, event, etc.

    config RT_RTI_OBJECT_TRYTAKE_HOOK
        bool "Use object try-take hook"
        default y
        help
            Enable RT-Thread object try-take hook (non-blocking).

    config RT_RTI_OBJECT_RELEASE_HOOK
        bool "Use object release hook"
        default y
        help
            Enable RT-Thread object release hook.

    config RT_RTI_TIMER_ENTER_HOOK
        bool "Use timer enter hook"
        default y
        help
            Enable RT-Thread timer enter hook.

    config RT_RTI_TIMER_EXIT_HOOK
        bool "Use timer exit hook"
        default y
        help
            Enable RT-Thread timer exit hook.

endif
```

## common/libraries/third_party/ampak/Kconfig
```kconfig
menuconfig RT_USING_MHD
    bool "Enable WiFi MHD Driver"
        default n
    select RT_USING_NETDEV
    select RT_WLAN_PROT_LWIP_ENABLE
    select RT_WLAN_PROT_LWIP_PBUF_FORCE
    select RT_WLAN_JOIN_SCAN_BY_MGNT
    select RT_USING_LWIP
    select RT_USING_SAL
    select RT_USING_WIFI
    select RT_USING_DFS
    help
        Enable MHD WiFi driver for AMPAK WiFi modules.
        This driver requires lwIP v2.1.2, select it manually if not selected.

if RT_USING_MHD
    choice
        prompt "WiFi Module Selection"
        default RT_WIFI_AP6212A

        config RT_WIFI_AP6212A
             bool "AP6212/AP6212A"
        config RT_WIFI_AP6236
             bool "AP6236"
        config RT_WIFI_AP6256
            bool "AP6256"
        config RT_WIFI_AP6201BM
            bool "AP6201BM"
        config RT_WIFI_AP6203BM
            bool "AP6203BM"
        config RT_WIFI_AP6303BH
            bool "AP6303BH"
        config RT_WIFI_AP6275S
            bool "AP6275S"
        config RT_WIFI_AP6281
            bool "AP6281"
        config RT_WIFI_AP6611S
            bool "AP6611S/AP12611_M2"
        config RT_WIFI_AP6XXX
            bool "AP6XXX"
    endchoice

if RT_WIFI_AP6XXX
        config RT_WIFI_AP6212A_SEL
             bool "AP6212/AP6212A"
        config RT_WIFI_AP6236_SEL
             bool "AP6236"
        config RT_WIFI_AP6256_SEL
            bool "AP6256"
        config RT_WIFI_AP6201BM_SEL
            bool "AP6201BM"
        config RT_WIFI_AP6203BM_SEL
            bool "AP6203BM"
        config RT_WIFI_AP6303BH_SEL
            bool "AP6303BH"
        config RT_WIFI_AP6275S_SEL
            bool "AP6275S"
        config RT_WIFI_AP6281_SEL
            bool "AP6281"
        config RT_WIFI_AP6611S_SEL
            bool "AP6611S/AP12611_M2"
endif

    config RT_WIFI_WL_REGON_PIN
        default "PD19"
        string "Set the WiFi WL_REG_ON pin name"
    config RT_WIFI_WL_HWAKE_PIN
        default "PD24"
        string "Set the WiFi WL_HWAKE pin name"

    config RT_MHD_THREAD_PRIORITY
            int "The priority level value for MHD thread"
            default 11
    config RT_MHD_THREAD_STACKSIZE
            int "The stack size for MHD thread"
            default 2048

    config RT_MHD_MFG_TEST
        bool "Select MFG FW Test Feature"
        default n

    config MEMP_OVERFLOW_CHECK
        int "Enable MEMP_OVERFLOW_CHECK"
        default 1
    config PBUF_LINK_HLEN
        int "PBUF_LINK_HLEN"
        default 48
    config LWIP_NETIF_TX_SINGLE_PBUF
        int "Enable LWIP_NETIF_TX_SINGLE_PBUF"
        default 1

endif
```
